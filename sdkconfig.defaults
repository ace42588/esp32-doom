## sdkconfig.defaults
```kconfig
# WiFi Configuration Optimizations for ESP32 Doom
# Aggressive optimization with 4MB PSRAM available
CONFIG_ESP32_WIFI_STATIC_RX_BUFFER_NUM=16
CONFIG_ESP32_WIFI_STATIC_TX_BUFFER_NUM=16
CONFIG_ESP32_WIFI_CACHE_TX_BUFFER_NUM=64
CONFIG_ESP32_WIFI_MGMT_SBUF_NUM=16
```
